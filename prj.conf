## CMakeLists.txt
```
cmake_minimum_required(VERSION 3.13.1)
project(GRR_CAN)

if(NOT cdc-acm-console IN_LIST SNIPPET)
  set(SNIPPET cdc-acm-console ${SNIPPET} CACHE STRING "" FORCE)
endif()

find_package(Zephyr)

# ── Generate board_config_generated.h from YAML ──────────────
find_package(Python3 COMPONENTS Interpreter REQUIRED)

set(BOARD_CONFIG_YAML "${CMAKE_CURRENT_LIST_DIR}/config/board_config.yaml")
set(BOARD_CONFIG_HDR  "${CMAKE_BINARY_DIR}/generated/board_config_generated.h")

add_custom_command(
    OUTPUT  ${BOARD_CONFIG_HDR}
    COMMAND ${Python3_EXECUTABLE}
            ${CMAKE_CURRENT_LIST_DIR}/scripts/generate_board_config.py
            ${BOARD_CONFIG_YAML}
            ${BOARD_CONFIG_HDR}
    DEPENDS ${BOARD_CONFIG_YAML}
            ${CMAKE_CURRENT_LIST_DIR}/scripts/generate_board_config.py
    COMMENT "Generating board_config_generated.h from YAML"
)
add_custom_target(board_config_gen DEPENDS ${BOARD_CONFIG_HDR})

# ── Application sources ──────────────────────────────────────
file(GLOB app_sources
    "${CMAKE_CURRENT_LIST_DIR}/src/*.c"
    "${CMAKE_CURRENT_LIST_DIR}/src/*.cpp"
    "${CMAKE_CURRENT_LIST_DIR}/src/*.cc"
    "${CMAKE_CURRENT_LIST_DIR}/src/*.cxx")

if(NOT app_sources)
  message(WARNING "No application sources found in ${CMAKE_CURRENT_LIST_DIR}/src")
else()
  target_sources(app PRIVATE ${app_sources})
endif()

# Make sure the generated header is built before compiling, and is findable
add_dependencies(app board_config_gen)
target_include_directories(app PRIVATE ${CMAKE_BINARY_DIR}/generated)
```

## prj.conf
```kconfig
CONFIG_GPIO=y
#CONFIG_MICROROS=y

CONFIG_MAIN_STACK_SIZE=25000
CONFIG_MAIN_THREAD_PRIORITY=3

CONFIG_NEWLIB_LIBC=y
CONFIG_NEWLIB_LIBC_NANO=n
# CONFIG_PTHREAD_IPC=n

CONFIG_POSIX_API=y
# CONFIG_POSIX_CLOCK=y

CONFIG_STDOUT_CONSOLE=y
CONFIG_LOG=y
CONFIG_SERIAL=y
CONFIG_UART_INTERRUPT_DRIVEN=y
CONFIG_UART_LINE_CTRL=y

# CAN Configuration
CONFIG_CAN=y
CONFIG_CAN_FD_MODE=y
CONFIG_CAN_MAX_FILTER=10

# Hardware Info (for unique device ID in ASSIGN_ID protocol)
CONFIG_HWINFO=y

# PWM Configuration for Motor and Servo Control
CONFIG_PWM=y

# USB Configuration
CONFIG_USB_DEVICE_INITIALIZE_AT_BOOT=y
CONFIG_USB_DEVICE_STACK=y
CONFIG_USB_CDC_ACM=y
CONFIG_CONSOLE=y
CONFIG_UART_CONSOLE=y

# C++ Support
CONFIG_CPP=y
CONFIG_STD_CPP17=y
CONFIG_LIB_CPLUSPLUS=y

# Floating Point
CONFIG_FPU=y

# Log Configuration
CONFIG_LOG_BUFFER_SIZE=4096
CONFIG_LOG_DEFAULT_LEVEL=3
```

## app.overlay
```dts
/* CAN-FD Interface Device Tree Overlay */

/ {
    chosen {
        zephyr,canbus = &flexcan3;
    };
    
    aliases {
        can0 = &flexcan3;
    };
};

&flexcan3 {
    status = "okay";
    bus-speed = <1000000>;      /* 1 Mbps nominal bitrate */
    bus-speed-data = <2000000>; /* 2 Mbps data bitrate for FD */
};

/* 
 * PWM configuration for motor and servo control
 * Uncomment and adjust based on your specific board/MCU
 */

/*
&pwm1 {
    status = "okay";
    pinctrl-0 = <&pwm1_default>;
    pinctrl-names = "default";
};

&pwm2 {
    status = "okay";
    pinctrl-0 = <&pwm2_default>;
    pinctrl-names = "default";
};
*/

/*
 * GPIO configuration for motor control signals
 * Uncomment and adjust based on your specific board/MCU
 */

/*
&gpio1 {
    status = "okay";
};
*/
```

## src/main.cpp
```c
// #define COLOR_SENSOR_DEBUG
// #define ARM_DEBUG

#include "ColorSensor.h"
#include "LED.h"
#include "Arm.h"


void setup() {
    // USB serial for printing
    Serial.begin(115200);

    // LEDs
    for (int i = 0; i < std::size(LEDS); i++) {
        for (int j = 0; j < 3; j++) {
            pinMode(LEDS[i][j], OUTPUT);
        }
    }

    // Color sensor
    ColorSensor::sensor = Adafruit_TCS34725(TCS34725_INTEGRATIONTIME_614MS, TCS34725_GAIN_1X);
    if (!ColorSensor::sensor.begin()) {
        Serial.println("ERROR: Color sensor failed to connect");
    }
    
    // Arm
    #define ServoSerialPort Serial1
    ServoSerialPort.begin(1000000);
    Arm::controller.pSerial = &ServoSerialPort;
    
    // Wait to ensure everything sets up
    delay(1000);
}

void loop() {
    Arm::move(ArmPositions::READ_COLOR);

    delay(1000);
    ColorSensor::readThenSetLED(0);
    
    Arm::move(ArmPositions::COLLAPSED);

    delay(3000);
}
```

## include/Arm.h
```c
#pragma once

#include <Arduino.h>
#include <SCServo.h>

#define SPEED 2400
#define ACCELERATION 50

struct ArmPosition {
    int servo1;
    int servo2;
};

// Predefined arm positions.
const ArmPosition _ARM_POSITIONS[] = {
    {53, 128},
    {10, 180},
    {90, 90},
    {173, 50},
    {150, 30},
};
// Indices for the predefined arm positions. This lets the teensies communicate
// an arm position over serial.
namespace ArmPositions {
    const uint8_t READ_COLOR = 0;
    const uint8_t COLLAPSED = 1;
    const uint8_t DOWN = 2;
    const uint8_t KNOCK_DUCK = 3;
    const uint8_t ANT_READ_COLOR = 4;
};

namespace BugPositions {
    const int COLLAPSED = 180;
    const int HELLDIVE = 30;
}

namespace Servos {
    SMS_STS controller = SMS_STS();

    void move(int id, int pos) {
        pos = map(pos, 0, 180, 0, 2000);

        if (
            pos < 0 ||
            pos > 2000
        ) {
            Serial.println("Ignoring move command; servos can only move between 0 and 2000.");
            return;
        }

        controller.WritePosEx(id, pos, SPEED * 1.25, ACCELERATION * 1.25);
    }

    void moveArm(uint8_t pos_idx) {
        if (pos_idx >= std::size(_ARM_POSITIONS)) {
            Serial.println("ERROR: Tried to move to nonexistant arm position");
            return;
        }

        ArmPosition pos = _ARM_POSITIONS[pos_idx];
        move(1, pos.servo1);
        move(2, pos.servo2);
        
        #ifdef ARM_DEBUG
        for (int i = 1; i <= 2; i++) {
            Serial.print("Servo ");
            Serial.print(i);
            Serial.print("'s position: ");
            Serial.println(controller.ReadPos(i));
        }
        Serial.println();
        #endif
    }
};
```

## include/ColorSensor.h
```c
#pragma once

#include <Arduino.h>
#include <Adafruit_TCS34725.h>

#include "LED.h"

struct Color {
  uint8_t r;
  uint8_t g;
  uint8_t b;
};

struct ReferenceColor {
    const char* name;
    Color match;
    Color led;
};

// Constant colors we reference against.
// We store the name of the color, the RGB to match against, and then the color we should send to our RGB LEDs.
const ReferenceColor COLORS[] = {
    // other readings
    // (151, 55, 42)
    {
        .name = "Red",
        .match = {255, 0, 0},
        .led = {HIGH, LOW, LOW}
    },
    // other readings
    // (38, 145, 56)
    {
        .name = "Green",
        .match = {0, 255, 0},
        .led = {LOW, HIGH, LOW}
    },
    // other readings
    // (28, 72, 149)
    // (43, 76, 130) perfect
    // (29, 75, 148) left
    // (23, 67, 171)
    {
        .name = "Blue",
        .match = {0, 0, 255},
        .led = {LOW, LOW, HIGH}
    },
    // for now we are ignoring purple and setting the color to purple if it reads blue and the red value is above 35.
    // See code in readThenSetLED.
    // // other readings
    // // (43, 63, 148)
    // {
    //     .name = "Purple",
    //     .match = {43, 63, 255},
    //     .led = {HIGH, LOW, HIGH}
    // }
};

namespace ColorSensor {
    Adafruit_TCS34725 sensor;

    // Function to calculate the "distance" between the current color and a target color using Euclidean distance in RGB space.
    float calculateEuclidianDistance(Color current, Color match) {
        float diffR = current.r - match.r;
        float diffG = current.g - match.g;
        float diffB = current.b - match.b;
        
        long sumOfSquares = (long)diffR * diffR + (long)diffG * diffG + (long)diffB * diffB;
        
        return sqrt(sumOfSquares);
    }

    void debugColor(Color color) {
        Serial.print("(");
        Serial.print(color.r); Serial.print(", ");
        Serial.print(color.g); Serial.print(", ");
        Serial.print(color.b);
        Serial.println(")");
    }

    uint16_t readLux() {
        float r, g, b;
        sensor.getRGB(&r, &g, &b);
        return sensor.calculateLux(r, g, b);
    }

    Color readColor() {
        float r, g, b;
        sensor.getRGB(&r, &g, &b);
        return {(uint8_t) std::round(r), (uint8_t) std::round(g), (uint8_t) std::round(b)};
    }

    void readThenSetLED(size_t led) {
        float r, g, b;
        sensor.getRGB(&r, &g, &b);
        Color read1 = readColor();
        delay(10);
        sensor.getRGB(&r, &g, &b);
        Color read2 = readColor();
        delay(10);
        sensor.getRGB(&r, &g, &b);
        Color read3 = readColor();
        delay(10);
        sensor.getRGB(&r, &g, &b);
        Color read4 = readColor();
        delay(10);
        sensor.getRGB(&r, &g, &b);
        Color read5 = readColor();

        uint8_t red = (read1.r + read2.r + read3.r + read4.r + read5.r)/5;
        uint8_t blue = (read1.b + read2.b + read3.b + read4.b + read5.b)/5;
        uint8_t green = (read1.g + read2.g + read3.g + read4.g + read5.g)/5;
        Color readFinal = {red, green, blue};

        #ifdef COLOR_SENSOR_TUNING
        Serial.print("Color sensor read: ");
        debugColor(readFinal);
        #endif

        float lowestDistance = INFINITY;
        Color closestColor = {LOW, LOW, LOW};
        for (ReferenceColor color : COLORS) {
            float distance = calculateEuclidianDistance(readFinal, color.match);
            if (distance < lowestDistance) {
                lowestDistance = distance;
                closestColor = color.led;
            }

            #ifdef COLOR_SENSOR_DEBUG
            Serial.print("Distance from ");
            Serial.print(color.name);
            Serial.print(": ");
            Serial.println(distance);
            #endif
        }
        if (closestColor.b == HIGH && readFinal.r > 40) {
            closestColor.r = HIGH;
        }

        setLedColor(led, closestColor.r, closestColor.g, closestColor.b);
    }
}
```

## include/LED.h
```c
#pragma once

#include <Arduino.h>

// LED pin definitions. Each LED (4 in total) has 3 pins for R, G, and B respectively.
const int LEDS[][3] = {
    {21, 17, 16},
    {2, 3, 4},
    {41, 13, 40},
    {7, 8, 9}
};

// Function to set the color of a specific LED (0-3) using a Color struct.
void setLedColor(size_t led, bool r, bool g, bool b) {
    if (led >= std::size(LEDS) || led < 0) {
        Serial.println("Invalid LED index");
        return;
    }

    digitalWrite(LEDS[led][0], r);
    digitalWrite(LEDS[led][1], g);
    digitalWrite(LEDS[led][2], b);  
}


void testAllLeds() {
    for(int i = 0; i < 4; i++) {
        setLedColor(i, 1, 0, 0);
        delay(1000);
        setLedColor(i, 0, 1, 0);
        delay(1000);
        setLedColor(i, 0, 0, 1);
        delay(1000);
        setLedColor(i, 1, 0, 1);
        delay(1000);

        setLedColor(i, 0, 0, 0);
    }
}
```

## include/SerialAtomics.h
```c
#pragma once

#include <Arduino.h>
#include <cinttypes>

enum Message: uint8_t {
    Invalid = 0,
    Ping = 1,
    Pong = 2,
    StartGame = 3,
    MoveArm = 4,
    MoveBugs = 5,
    ReadThenSetLED = 6,
    StartKnob = 7,
    StopKnob = 8,
    StartSolenoids = 9,
    StopSolenoids = 10,
};
const uint8_t MESSAGE_MAX = Message::StopSolenoids;

namespace SerialAtomics {
    void setup() {
        Serial7.begin(9600);
    }

    void send(uint8_t byte) {
        Serial7.write(byte);
    }

    uint8_t recvByte() {
        while (Serial7.available() < 1) {
            delay(10);
        }
        int byte = Serial7.read();

        return (uint8_t) byte;
    }

    Message recvMsg() {
        uint8_t byte = recvByte();
        if (byte <= MESSAGE_MAX && byte >= 0) {
            return (Message) byte;
        } else {
            Serial.println("Error: Received undefined message " + String(byte));
            return Message::Invalid;
        }
    }
}
```

## include/bldc_motor_controller.h
```c
#ifndef BLDC_MOTOR_CONTROLLER_H
#define BLDC_MOTOR_CONTROLLER_H

#include <Arduino.h>
#include "pid_controller.h"

/**
 * Brushless Motor Controller for Pololu A89301 Driver
 * 
 * Pin descriptions:
 * - DIR:     Direction input - controls motor phase order (LOW/HIGH)
 * - SPD:     Speed input - analog voltage, PWM duty cycle, or pulse frequency
 *            2.5V analog = max speed, 5V tolerant. Also I2C SCL.
 * - BRAKE:   Brake input - HIGH drives all motor outputs low for electrical braking
 * - FAULT:   Fault indicator - open-drain, normally HIGH (pulled to IOREF),
 *            driven LOW in patterns to indicate faults
 * - FG:      Frequency Generator output - motor speed feedback (tachometer)
 *            Also I2C SDA line, pulled up to IOREF
 * - EN_OUTA/B/C: Encoder inputs for position/velocity feedback
 */

/* Fault codes from A89301 (blink patterns) */
enum BrushlessFaultCode {
    FAULT_NONE = 0,
    FAULT_OVERCURRENT = 1,      // 1 blink
    FAULT_OPEN_LOAD = 2,        // 2 blinks
    FAULT_SHORT_CIRCUIT = 3,    // 3 blinks
    FAULT_OVERTEMP = 4,         // 4 blinks
    FAULT_UNDERVOLTAGE = 5,     // 5 blinks
    FAULT_UNKNOWN = 255
};

/* Motor state */
enum BrushlessMotorState {
    BLDC_STATE_IDLE = 0,
    BLDC_STATE_RUNNING = 1,
    BLDC_STATE_BRAKING = 2,
    BLDC_STATE_FAULT = 3,
    BLDC_STATE_ESTOP = 4
};

class BrushlessMotorController {
public:
    /**
     * Constructor for A89301 brushless motor driver
     * @param dirPin    Direction control pin
     * @param spdPin    Speed control pin (PWM output)
     * @param brakePin  Brake control pin
     * @param faultPin  Fault indicator input (active LOW)
     * @param encA      Encoder channel A (EN_OUTA)
     * @param encB      Encoder channel B (EN_OUTB)
     * @param encC      Encoder channel C (EN_OUTC) - for commutation or index
     * @param fgPin     Frequency generator input (speed feedback from motor)
     */
    BrushlessMotorController(int dirPin, int spdPin, int brakePin, int faultPin, 
                    int encA, int encB, int encC, int fgPin);
    
    ~BrushlessMotorController();
    
    /**
     * Initialize motor controller hardware
     * @return true if initialization successful
     */
    bool begin();
    
    /**
     * Set motor linear velocity in meters/second.
     * Sign controls direction (+ forward, - reverse).
     * Internally converted to RPM using wheel radius.
     * @param velocityMps Target wheel linear velocity in m/s
     */
    void setSpeed(float velocityMps);
    
    /**
     * Set motor speed in RPM.
     * - If PID is enabled: sets the closed-loop target RPM.
     * - If PID is disabled: maps RPM to PWM effort open-loop.
     * @param rpm Target RPM (-maxRPM to +maxRPM)
     */
    void setRPM(float rpm);
    
    /**
     * Set PWM effort directly (duty cycle magnitude only).
     * Direction is controlled separately by setDirection().
     * @param effort PWM effort (0 to 255)
     */
    void setEffort(int effort);
    
    /**
     * Get current motor RPM from encoder
     * @return Current RPM
     */
    float getRPM();
    
    /**
     * Get RPM from frequency generator (FG) pin
     * @return RPM calculated from FG pulses
     */
    float getRPMFromFG();
    
    /**
     * Get current encoder position
     * @return Encoder count
     */
    long getEncoderPosition();
    
    /**
     * Reset encoder position to zero
     */
    void resetEncoder();
    
    /**
     * Engage electrical brake (all phases driven low)
     */
    void brake();
    
    /**
     * Release brake and allow motor to coast
     */
    void releaseBrake();
    
    /**
     * Emergency stop - brake and disable
     */
    void emergencyStop();
    
    /**
     * Enable motor after E-stop
     */
    void enable();
    
    /**
     * Check if motor is in fault condition
     * @return true if fault detected
     */
    bool isFaulted();
    
    /**
     * Get the fault pin number (for external monitoring)
     * @return Fault pin number
     */
    int getFaultPin();
    
    /**
     * Read and decode fault pattern from FAULT pin
     * @return BrushlessFaultCode indicating fault type
     */
    BrushlessFaultCode readFaultCode();
    
    /**
     * Get current motor state
     * @return BrushlessMotorState
     */
    BrushlessMotorState getState();
    
    /**
     * Set direction
     * @param forward true for forward, false for reverse
     */
    void setDirection(bool forward);
    
    /**
     * Configure encoder parameters
     * @param ticksPerRev Encoder ticks per motor revolution
     * @param gearRatio Gear ratio (output/input)
     */
    void setEncoderParams(int ticksPerRev, float gearRatio);
    
    /**
     * Configure FG parameters
     * @param pulsesPerRev Number of FG pulses per motor revolution
     */
    void setFGParams(int pulsesPerRev);
    
    /**
     * Set maximum RPM for speed mapping
     * @param maxRPM Maximum motor RPM
     */
    void setMaxRPM(float maxRPM);

    /* ---- Closed-loop (PID) velocity control ---- */

    /**
     * Run one iteration of the PID velocity loop.
     * Call this from your main loop as fast as possible (or at a fixed rate).
     * Uses encoder RPM as feedback by default; set useEncoderFeedback(false)
     * to use the FG pin instead.
     */
    void update();

    /**
     * Enable or disable closed-loop PID control.
    * When disabled, setSpeed and setRPM work open-loop.
     * @param enabled true to enable PID
     */
    void setPIDEnabled(bool enabled);

    /**
     * Check if PID control is currently active
     */
    bool isPIDEnabled() const { return _pidEnabled; }

    /**
     * Configure PID gains
     */
    void setPIDGains(float kp, float ki, float kd);

    /**
     * Choose feedback source for PID loop
     * @param useEncoder  true = encoder (default), false = FG pin
     */
    void useEncoderFeedback(bool useEncoder);

    /**
    * Get the current target RPM set by setRPM()
     */
    float getTargetRPM() const { return _targetRPM; }

    /**
     * Get a reference to the internal PID controller for advanced tuning
     */
    PIDController& pid() { return _pid; }

private:
    // Pin assignments
    int _dirPin;
    int _spdPin;
    int _brakePin;
    int _faultPin;
    int _encA;
    int _encB;
    int _encC;
    int _fgPin;
    
    // Encoder (manual quadrature decode on A/B/C pins via ISR)
    volatile long _encoderCount;
    long _lastEncoderCount;
    unsigned long _lastEncoderTime;
    volatile uint8_t _lastEncState;  // previous AB state for quadrature lookup
    
    // FG (Frequency Generator) measurement
    volatile unsigned long _fgPulseCount;
    unsigned long _lastFGCount;
    unsigned long _lastFGTime;
    
    // Motor parameters
    int _ticksPerRev;
    float _gearRatio;
    int _fgPulsesPerRev;
    float _maxRPM;
    float _wheelRadiusMeters;
    
    // State
    BrushlessMotorState _state;
    bool _brakeEngaged;
    bool _direction;  // true = forward
    int _currentPWM;
    
    // Fault detection
    unsigned long _lastFaultCheck;
    int _faultBlinkCount;

    // PID velocity control
    PIDController _pid;
    float _targetRPM;
    bool _pidEnabled;
    bool _useEncoderFeedback;   // true = encoder, false = FG
    unsigned long _pidSatStartMs;      // timestamp when saturation began
    static constexpr unsigned long PID_SAT_WARN_MS = 2000;  // warn after 2 s saturated
    
    // Static ISR handling for FG and encoder pins
    static BrushlessMotorController* _instances[4];
    static int _instanceCount;
    int _instanceIndex;

    // FG pin ISRs
    static void fgISR0();
    static void fgISR1();
    static void fgISR2();
    static void fgISR3();
    void handleFGPulse();

    // Encoder A/B pin ISRs (quadrature decode)
    static void encISR0();
    static void encISR1();
    static void encISR2();
    static void encISR3();
    void handleEncoderPulse();

    // Encoder C (index) ISRs
    static void idxISR0();
    static void idxISR1();
    static void idxISR2();
    static void idxISR3();
    void handleIndexPulse();
};

#endif
```

## include/board_builder.h
```c
#ifndef BOARD_BUILDER_H
#define BOARD_BUILDER_H

#include <zephyr/device.h>
#include <zephyr/drivers/pwm.h>
#include <zephyr/drivers/gpio.h>
#include <zephyr/drivers/can.h>

/* Controller headers */
#include "brushed_motor_controller.h"
#include "brushless_motor_controller.h"
#include "servo_controller.h"
#include "grr_can.h"

/* Generated config – produced by scripts/generate_board_config.py */
#include "board_config_generated.h"

/* ================================================================
 *   BoardBuilder
 * ================================================================
 * Reads the compile-time #defines from board_config_generated.h
 * and constructs + initialises every controller declared in the
 * YAML config.
 *
 * Usage:
 *   BoardBuilder builder;
 *   if (!builder.build()) { LOG_ERR("build failed"); }
 *
 *   // Access controllers:
 *   builder.brushed_motors[0].setVelocity(500);
 *   builder.servos[1].setAngleDegrees(45.0f);
 * ================================================================ */

struct BoardBuilder {

    /* ---- Public arrays sized by generated config ---- */
#if NUM_BRUSHED_MOTORS > 0
    BrushedMotorController   brushed_motors[NUM_BRUSHED_MOTORS];
#endif
#if NUM_BRUSHLESS_MOTORS > 0
    BrushlessMotorController brushless_motors[NUM_BRUSHLESS_MOTORS];
#endif
#if NUM_SERVOS > 0
    PWMServoController       servos[NUM_SERVOS];
#endif

    /* ---- Build everything from generated defines ---- */
    bool build();

    /* ---- Convenience: emergency-stop all actuators ---- */
    void emergencyStopAll();

    /* ---- Convenience: update all controllers ---- */
    void updateAll(float dt);

    /* ---- Convenience: send CAN status for all ---- */
    void sendAllStatus();
};

#endif /* BOARD_BUILDER_H */
```

## include/brushed_motor_controller.h
```c
#ifndef BRUSHED_MOTOR_CONTROLLER_H
#define BRUSHED_MOTOR_CONTROLLER_H

#include <zephyr/device.h>
#include <zephyr/sys/printk.h>
#include <stddef.h>
#include <zephyr/drivers/gpio.h>
#include <zephyr/drivers/pwm.h>
#include <zephyr/drivers/adc.h>
#include <zephyr/logging/log.h>
#include <zephyr/drivers/can.h>

/* ================================================================
 *   Brushed Motor Control Modes & States
 * ================================================================
 * Brushed motors are simpler than brushless:
 *   - Driven via H-bridge (DIR + PWM + SLP + FLT)
 *   - Current sense via analog CS pin
 *   - Optional quadrature encoder (EN_OUTA / EN_OUTB)
 * ================================================================ */

enum BrushedMotorControlMode {
    BRUSHED_MODE_VELOCITY = 0,    /* Closed-loop velocity (requires encoder) */
    BRUSHED_MODE_POSITION = 1,    /* Closed-loop position (requires encoder) */
    BRUSHED_MODE_EFFORT   = 2,    /* Open-loop PWM duty cycle */
    BRUSHED_MODE_DISABLED = 3
};

enum BrushedMotorState {
    BRUSHED_STATE_IDLE        = 0,
    BRUSHED_STATE_RUNNING     = 1,
    BRUSHED_STATE_FAULT       = 2,
    BRUSHED_STATE_CALIBRATING = 3,
    BRUSHED_STATE_ESTOP       = 4
};

/* Brushed Motor CAN Command (8 bytes) – same wire format as brushless */
struct BrushedMotorCANCommand {
    uint8_t  motor_id;       /* Motor identifier                           */
    uint8_t  control_mode;   /* BrushedMotorControlMode enum               */
    int16_t  target_value;   /* Velocity (RPM) / position (ticks) / effort */
    uint8_t  flags;          /* Enable, direction, brake, reset-fault      */
    uint8_t  reserved[3];
} __attribute__((packed));

/* Brushed Motor CAN Status (8 bytes) */
struct BrushedMotorCANStatus {
    uint8_t  motor_id;
    uint8_t  state;          /* BrushedMotorState enum    */
    int16_t  current_velocity;
    int16_t  current_position;
    uint8_t  fault_code;
    uint8_t  temperature;    /* °C, 0 if not available    */
} __attribute__((packed));

/* Command flag bits (identical to brushless for CAN interoperability) */
#define BRUSHED_FLAG_ENABLE       (1 << 0)
#define BRUSHED_FLAG_DIRECTION    (1 << 1)
#define BRUSHED_FLAG_BRAKE        (1 << 2)
#define BRUSHED_FLAG_RESET_FAULT  (1 << 3)

/* Fault codes */
#define BRUSHED_FAULT_NONE        0x00
#define BRUSHED_FAULT_OVERCURRENT 0x01
#define BRUSHED_FAULT_DRIVER      0x02
#define BRUSHED_FAULT_STALL       0x03
#define BRUSHED_FAULT_ENCODER     0x04

class BrushedMotorController {
private:
    /* ---- H-Bridge Interface ---- */
    const struct device *pwm_dev;
    uint32_t pwm_channel;
    uint32_t pwm_period_ns;        /* PWM period (default 50 µs → 20 kHz) */

    const struct device *gpio_dev;
    gpio_pin_t dir_pin;            /* Direction */
    gpio_pin_t slp_pin;            /* Sleep / enable (active-low on many drivers) */
    gpio_pin_t flt_pin;            /* Fault input (active-low) */

    /* ---- Current Sense ---- */
    const struct device *adc_dev;
    uint8_t  cs_adc_channel;
    int32_t  current_ma;           /* Last sampled motor current in mA */
    int32_t  overcurrent_ma;       /* Trip threshold */

    /* ---- Quadrature Encoder ---- */
    const struct device *enc_gpio_dev;
    gpio_pin_t enc_a_pin;
    gpio_pin_t enc_b_pin;
    volatile int32_t encoder_ticks;
    int32_t  ticks_per_rev;        /* Encoder resolution */

    /* ---- Identity ---- */
    uint8_t  motor_id;
    const char *joint_name;

    /* ---- Control State ---- */
    BrushedMotorControlMode control_mode;
    BrushedMotorState       state;

    float   target_velocity;       /* RPM */
    float   current_velocity;      /* RPM (computed from encoder) */
    int32_t target_position;       /* Encoder ticks */
    int32_t current_position;      /* Encoder ticks */
    int16_t target_effort;         /* Duty-cycle % × 100 (–10 000 … +10 000) */
    uint8_t fault_code;

    /* ---- PID ---- */
    float kp, ki, kd;
    float integral_error;
    float last_error;

    /* ---- Limits ---- */
    float   max_velocity;          /* RPM */
    float   max_acceleration;      /* RPM / s */
    int32_t min_position;
    int32_t max_position;
    float   max_duty;              /* 0-100 % */

    /* ---- Stall detection ---- */
    uint32_t stall_count;
    uint32_t stall_threshold;      /* Consecutive zero-velocity samples */

    /* ---- Internal helpers ---- */
    void    applyPWM(float duty_pct);
    float   computePID(float setpoint, float measured);
    void    checkFaults();
    void    readCurrentSense();
    void    updateEncoder();

public:
    BrushedMotorController();
    BrushedMotorController(uint8_t id, const char *name);
    ~BrushedMotorController();

    /* ---- Hardware init ---- */
    bool init(const struct device *pwm, uint32_t channel, uint32_t period_ns,
              const struct device *gpio, gpio_pin_t dir, gpio_pin_t slp, gpio_pin_t flt);

    /* Optional: attach encoder */
    bool attachEncoder(const struct device *enc_gpio, gpio_pin_t a, gpio_pin_t b,
                       int32_t ticks_per_revolution);

    /* Optional: attach current-sense ADC */
    bool attachCurrentSense(const struct device *adc, uint8_t channel, int32_t overcurrent_limit_ma);

    /* ---- Control ---- */
    void setControlMode(BrushedMotorControlMode mode);
    void setVelocity(float rpm);
    void setPosition(int32_t ticks);
    void setEffort(int16_t effort);       /* –10 000 … +10 000 */
    void enable();
    void disable();
    void emergencyStop();
    void resetFault();

    /* ---- Feedback ---- */
    float   getVelocity()   const;
    int32_t getPosition()   const;
    int16_t getEffort()     const;
    int32_t getCurrentMA()  const;
    BrushedMotorState getState() const;
    uint8_t getFaultCode()  const;
    uint8_t getMotorId()    const;
    const char* getJointName() const;

    /* ---- Tuning ---- */
    void setPIDGains(float p, float i, float d);
    void setLimits(float max_vel, float max_accel, int32_t min_pos, int32_t max_pos);
    void setMaxDuty(float pct);
    void setStallThreshold(uint32_t samples);
    void setTicksPerRev(int32_t tpr);

    /* ---- CAN interface ---- */
    bool processCANCommand(const struct can_frame *frame);
    bool sendCANStatus(const struct device *can_dev);

    /* ---- Periodic update (call from control loop) ---- */
    void update(float dt);
};

#endif /* BRUSHED_MOTOR_CONTROLLER_H */
```

## include/brushless_motor_controller.h
```c
#ifndef MOTOR_CONTROLLER_H
#define MOTOR_CONTROLLER_H

#include <zephyr/device.h>
#include <zephyr/sys/printk.h>
#include <stddef.h>
#include <zephyr/drivers/sensor.h>
#include <zephyr/drivers/gpio.h>
#include <zephyr/drivers/pwm.h>
#include <zephyr/logging/log.h>
#include <zephyr/drivers/can.h>

/* Brushless Motor Control Modes */
enum MotorControlMode {
    MOTOR_MODE_VELOCITY = 0,
    MOTOR_MODE_POSITION = 1,
    MOTOR_MODE_TORQUE = 2,
    MOTOR_MODE_DISABLED = 3
};

/* Motor State */
enum MotorState {
    MOTOR_STATE_IDLE = 0,
    MOTOR_STATE_RUNNING = 1,
    MOTOR_STATE_FAULT = 2,
    MOTOR_STATE_CALIBRATING = 3,
    MOTOR_STATE_ESTOP = 4
};

/* Motor CAN Command Structure (8 bytes) */
struct MotorCANCommand {
    uint8_t motor_id;           // Motor identifier
    uint8_t control_mode;       // MotorControlMode enum
    int16_t target_value;       // Target velocity/position/torque (scaled)
    uint8_t flags;              // Enable, direction, brake flags
    uint8_t reserved[3];        // Reserved for future use
} __attribute__((packed));

/* Motor CAN Status Structure (8 bytes) */
struct MotorCANStatus {
    uint8_t motor_id;           // Motor identifier
    uint8_t state;              // MotorState enum
    int16_t current_velocity;   // Current velocity (scaled)
    int16_t current_position;   // Current position (scaled)
    uint8_t fault_code;         // Fault code if any
    uint8_t temperature;        // Motor temperature in Celsius
} __attribute__((packed));

/* Motor command flags */
#define MOTOR_FLAG_ENABLE       (1 << 0)
#define MOTOR_FLAG_DIRECTION    (1 << 1)
#define MOTOR_FLAG_BRAKE        (1 << 2)
#define MOTOR_FLAG_RESET_FAULT  (1 << 3)

class BrushlessMotorController {
private:
    /* PWM device and channel for motor control */
    const struct device *pwm_dev;
    uint32_t pwm_channel;
    uint32_t pwm_period_ns;
    
    /* GPIO pins */
    const struct device *gpio_dev;
    gpio_pin_t enable_pin;
    gpio_pin_t direction_pin;
    gpio_pin_t brake_pin;
    gpio_pin_t fault_pin;
    
    /* Motor parameters */
    uint8_t motor_id;
    const char *joint_name;
    MotorControlMode control_mode;
    MotorState state;
    
    /* Current values */
    float target_velocity;
    float current_velocity;
    int32_t target_position;
    int32_t current_position;
    float target_torque;
    uint8_t fault_code;
    
    /* PID parameters */
    float kp, ki, kd;
    float integral_error;
    float last_error;
    
    /* Limits */
    float max_velocity;
    float max_acceleration;
    int32_t min_position;
    int32_t max_position;
    
    /* Internal methods */
    void updatePWM(float duty_cycle);
    float computePID(float setpoint, float current);
    void checkFaults();

public:
    BrushlessMotorController();
    BrushlessMotorController(uint8_t id, const char *name);
    ~BrushlessMotorController();
    
    /* Initialization */
    bool init(const struct device *pwm, uint32_t channel, uint32_t period_ns,
              const struct device *gpio, gpio_pin_t en, gpio_pin_t dir, 
              gpio_pin_t brk, gpio_pin_t flt);
    
    /* Control methods */
    void setControlMode(MotorControlMode mode);
    void setVelocity(float velocity);
    void setPosition(int32_t position);
    void setTorque(float torque);
    void enable();
    void disable();
    void emergencyStop();
    void resetFault();
    
    /* Feedback methods */
    float getVelocity() const;
    int32_t getPosition() const;
    float getTorque() const;
    MotorState getState() const;
    uint8_t getFaultCode() const;
    uint8_t getMotorId() const;
    const char* getJointName() const;
    
    /* PID tuning */
    void setPIDGains(float p, float i, float d);
    void setLimits(float max_vel, float max_accel, int32_t min_pos, int32_t max_pos);
    
    /* CAN interface */
    bool processCANCommand(const struct can_frame *frame);
    bool sendCANStatus(const struct device *can_dev);
    
    /* Periodic update - call from control loop */
    void update(float dt);
};

/* Legacy compatibility class */
class MotorController {
private:
    int DIR;
    int PWM;
    int SLP;
    int FLT;
    int CS;
    int EN_OUTA;
    int EN_OUTB;
    const char *joint_name;
    const char *control_type;

public:
    MotorController(int DIR, int PWM, int SLP, int FLT, int EN_OUTA, int EN_OUTB, int CS, const char *joint_name, const char *control_type);
    MotorController();
    void setMotorVelocity(float velocity);
    void setMotorEffort(int effort);
    float getMotorVelocity();
    int getMotorEffort();
    int getRPM();
    int getCurrent();
    bool isFaulted();
    const char *getJointName();
    const char *getControlType();
};

#endif // MOTOR_CONTROLLER_H
```

## include/can_bootloader.h
```c
#ifndef CAN_BOOTLOADER_H
#define CAN_BOOTLOADER_H

#include <zephyr/drivers/can.h>

#ifdef __cplusplus
extern "C" {
#endif

void can_bootloader_init(const struct device *can_device);
void bootloader_can_callback(const struct can_frame *frame, void *user_data);

#ifdef __cplusplus
}
#endif

#endif /* CAN_BOOTLOADER_H */
```

## include/grr_can.h
```c
#ifndef GRR_CAN_H
#define GRR_CAN_H

#include <sys/types.h>
#include <zephyr/device.h>
#include <zephyr/drivers/hwinfo.h>
#include <zephyr/sys/printk.h>
#include <zephyr/drivers/can.h>

/* CAN message IDs (keep consistent with your original enums) */
enum CAN_IDs {
    E_STOP = 0x000,
    HALT = 0x100,
    RESTART = 0x200,
    HEARTBEAT = 0x300,
    QUERY = 0x400,
    ASSIGN_ID = 0x500,
    FIRMWARE = 0x600,
    FATAL = 0x1000,
    ERROR = 0x2000,
    MOTOR_COMMAND = 0x3000,
    MOTOR_STATUS = 0x3100,
    SERVO_CONTROL = 0x4000,
    SERVO_STATUS = 0x4100,
    DIO = 0x5000,
    SENSORS = 0x6000,
    WARNINGS = 0x7000,
    LOGS = 0x8000,
    MOANING = 0xFFFE,
    SGA_WARRANTY = 0xFFFF
};

/* CAN ID masks for filtering */
#define CAN_MASK_EXACT      0x7FF       // Match exact 11-bit ID
#define CAN_MASK_GROUP      0x7F00      // Match message group (upper byte)
#define CAN_MASK_MOTOR      0x7F00      // Motor commands 0x30xx
#define CAN_MASK_SERVO      0x7F00      // Servo commands 0x40xx

/* ================================================================
 *   ASSIGN_ID sub-commands  (data[0] of an ASSIGN_ID frame)
 * ================================================================
 *   Multiple Teensies share the same CAN bus.  Each one has a
 *   hardware-unique ID (Zephyr hwinfo or manual).  The CAN master
 *   uses the following protocol:
 *
 *   1. Master sends  ASSIGN_ID  with sub-cmd ASSIGN_SUBCMD_QUERY_UID.
 *      All nodes respond with ASSIGN_SUBCMD_ANNOUNCE containing
 *      their 4-byte UID + current node_id.
 *
 *   2. Master sends  ASSIGN_ID  with sub-cmd ASSIGN_SUBCMD_SET,
 *      including the target UID (4 bytes) and the new node_id.
 *      Only the node whose UID matches applies the new ID.
 * ================================================================ */
#define ASSIGN_SUBCMD_QUERY_UID  0x01   /* Master → all : "who's there?" */
#define ASSIGN_SUBCMD_ANNOUNCE   0x02   /* Node  → master: UID + current ID */
#define ASSIGN_SUBCMD_SET        0x03   /* Master → node : UID + new ID    */

/* Maximum hardware UID length in bytes (we use the first 4) */
#define HW_UID_LEN               4

/* Node ID - can be configured via ASSIGN_ID command */
extern uint8_t g_node_id;

/* Hardware unique ID (populated at boot from hwinfo or config) */
extern uint8_t g_hw_uid[HW_UID_LEN];

/* CAN device accessor */
const struct device* get_can_device(void);

/* Initialization */
bool init_can(void);
bool setup_can_filters(struct k_msgq *msgq);

/* Message sending */
bool send_heartbeat(void);
bool send_can_frame(uint32_t id, const uint8_t *data, uint8_t len, bool is_fd);
bool send_motor_status(uint8_t motor_id, uint8_t state, int16_t velocity, 
                       int16_t position, uint8_t fault, uint8_t temp);
bool send_servo_status(uint8_t servo_id, uint8_t state, int16_t current_angle,
                       int16_t target_angle, uint8_t load, uint8_t fault);

/* Unique-ID handshake – call once after CAN init to populate g_hw_uid
 * and broadcast an ANNOUNCE so the master knows we exist. */
void can_announce_uid(void);

/* Message handling */
bool handle_incoming_frame(struct can_frame *frame);

/* Device info */
const char *getDeviceInfo(void);

/* Forward declarations for motor/servo handlers - implemented in respective modules */
typedef void (*motor_command_handler_t)(const struct can_frame *frame);
typedef void (*servo_command_handler_t)(const struct can_frame *frame);

void register_motor_command_handler(motor_command_handler_t handler);
void register_servo_command_handler(servo_command_handler_t handler);

#endif // GRR_CAN_H
```

## include/knob_servo.h
```c
#pragma once

#include <Arduino.h>
#include <Servo.h>

void initKnobServo(int servoPin);
void spinKnobServo(int pulse);
```

## include/mecanum_controller.h
```c
#ifndef MECANUM_CONTROLLER_H
#define MECANUM_CONTROLLER_H

class MecanumController {
public:
    MecanumController(float wheelBase, float trackWidth, float wheelDiameter = 0.075f);
    float getWheelBase();
    float getTrackWidth();
    float getWheelDiameter();

    float* calculateMecanumWheelSpeeds(float linear_x, float linear_y, float angular_z);

private:
    float wheelBase;
    float trackWidth;
    float wheelDiameter; 

};

#endif
```
